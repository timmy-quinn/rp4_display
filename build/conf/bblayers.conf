## build/conf/bblayers.conf
```bitbake
# POKY_BBLAYERS_CONF_VERSION is increased each time build/conf/bblayers.conf
# changes incompatibly
POKY_BBLAYERS_CONF_VERSION = "2"

BBPATH = "${TOPDIR}"
BBFILES ?= ""

BBLAYERS ?= " \
  ${TOPDIR}/../src/poky/meta \
  ${TOPDIR}/../src/poky/meta-poky \
  ${TOPDIR}/../src/poky/meta-yocto-bsp \
  ${TOPDIR}/../src/meta-raspberrypi \
  ${TOPDIR}/../src/meta-openembedded/meta-oe \
  ${TOPDIR}/../src/meta-mylayer \
  "
```
